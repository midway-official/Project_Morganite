/ {
    cpus {
        timebase-frequency = <100000000>;
    };
    soc {
        gpu@1fe20000 {
            compatible = "morganite,gpu-v1";
            reg = <0x1fe20000 0x1000>;
        };
    };
};
